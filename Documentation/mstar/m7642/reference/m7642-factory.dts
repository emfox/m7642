/dts-v1/;

/ {
	compatible = "arm,foundation-aarch64", "arm,m7642";
	#address-cells = <0x2>;
	model = "M7642";
	interrupt-parent = <0x1>;
	#size-cells = <0x2>;

	Mstar-lp-standby {
		compatible = "Mstar-lp-standby";
	};

	emmc_osp_int {
		compatible = "emmc_osp_int";
		interrupts = <0x0 0x1a 0x4>;
	};

	evd_int {
		compatible = "evd_int";
		interrupts = <0x0 0xd 0x4>;
	};

	Mstar-udc {
		compatible = "Mstar-udc";
	};

	tsp2aeon_int {
		compatible = "tsp2aeon_int";
		interrupts = <0x0 0x4f 0x4>;
	};

	aia_sec_int {
		compatible = "aia_sec_int";
		interrupts = <0x0 0xbf 0x4>;
	};

	bdma_merge {
		compatible = "Mstar-dipw";
	};

	cilink_soc_if {
		compatible = "cilink_soc_if";
		interrupts = <0x0 0xb2 0x4>;
	};

	HDMI_NON_PCM_MODE_INT_OUT {
		compatible = "HDMI_NON_PCM_MODE_INT_OUT";
		interrupts = <0x0 0x4b 0x4>;
	};

	reg_hst2to3_int {
		compatible = "reg_hst2to3_int";
		interrupts = <0x0 0x6c 0x4>;
	};

	fcie_tee_int {
		compatible = "fcie_tee_int";
		interrupts = <0x0 0x36 0x4>;
	};

	dc_int {
		compatible = "dc_int";
		interrupts = <0x0 0x13 0x4>;
	};

	pcm2mcu_int {
		compatible = "pcm2mcu_int";
		interrupts = <0x0 0xae 0x4>;
	};

	vbi_int {
		compatible = "vbi_int";
		interrupts = <0x0 0x1c 0x4>;
	};

	mspi_cilink_int {
		compatible = "mspi_cilink_int";
		interrupts = <0x0 0x29 0x4>;
	};

	usb_int_merge3 {
		compatible = "usb_int_merge3";
		interrupts = <0x0 0x43 0x4>;
	};

	miic2_int {
		compatible = "miic2_int";
		interrupts = <0x0 0x2c 0x4>;
	};

	mod_detect_intr {
		compatible = "mod_detect_intr";
		interrupts = <0x0 0xf 0x4>;
	};

	int_uart4 {
		compatible = "int_uart4";
		interrupts = <0x0 0xab 0x4>;
	};

	MB_auR2toMCU_INT2 {
		compatible = "MB_auR2toMCU_INT2";
		interrupts = <0x0 0x5e 0x4>;
	};

	thermal-zones {

		mtk-thermal {
			polling-delay = <0x3e8>;
			polling-delay-passive = <0x64>;
			thermal-sensors = <0x6 0x0>;

			cooling-maps {

				map0 {
					cooling-device = <0x8 0xffffffff 0xffffffff>;
					trip = <0x7>;
					contribution = <0x400>;
				};
			};

			trips {

				trip-point@1 {
					phandle = <0x7>;
					temperature = <0x1e848>;
					hysteresis = <0x3e8>;
					linux,phandle = <0x7>;
					type = "passive";
				};

				trip-point@0 {
					temperature = <0x1c138>;
					hysteresis = <0x3e8>;
					type = "passive";
				};
			};
		};
	};

	scm_int {
		compatible = "scm_int";
		interrupts = <0x0 0x1b 0x4>;
	};

	xiu_timeout_int {
		compatible = "xiu_timeout_int";
		interrupts = <0x0 0x53 0x4>;
	};

	pm_sleep_int {
		compatible = "pm_sleep_int";
		interrupts = <0x0 0x1 0x4>;
	};

	comb_int {
		compatible = "comb_int";
		interrupts = <0x0 0xe 0x4>;
	};

	ext_gpio_int4 {
		compatible = "ext_gpio_int4";
		interrupts = <0x0 0x78 0x4>;
	};

	reg_hst2to0_int {
		compatible = "reg_hst2to0_int";
		interrupts = <0x0 0x6e 0x4>;
	};

	Mstar-usb {
		compatible = "Mstar-usb";
	};

	pwm_rp_r_int {
		compatible = "pwm_rp_r_int";
		interrupts = <0x0 0x7d 0x4>;
	};

	sdio_int {
		compatible = "sdio_int";
		interrupts = <0x0 0x3b 0x4>;
	};

	pka_all_int {
		compatible = "pka_all_int";
		interrupts = <0x0 0x2f 0x4>;
	};

	uhc_int {
		compatible = "uhc_int";
		interrupts = <0x0 0x7 0x4>;
	};

	mvd {
		compatible = "mvd";
	};

	ps_int {
		compatible = "ps_int";
		interrupts = <0x0 0x4 0x4>;
	};

	usb_int1 {
		compatible = "usb_int1";
		interrupts = <0x0 0x21 0x4>;
	};

	int_uart1 {
		compatible = "int_uart1";
		interrupts = <0x0 0x27 0x4>;
	};

	AU_SPDIF_TX_CS_INT1 {
		compatible = "AU_SPDIF_TX_CS_INT1";
		interrupts = <0x0 0x45 0x4>;
	};

	int_bdma_merge {
		compatible = "int_bdma_merge";
		interrupts = <0x0 0x30 0x4>;
	};

	i2c@1 {
		hw-port = <0x0>;
		pad-mux = <0x0>;
		speed-khz = <0x64>;
		status = "okay";
		compatible = "mstar,swi2c";
		def-delay = <0x64>;
		scl-gpio = <0x8e>;
		iic-mode = <0x0>;
		bus-index = <0x1>;
		retries = <0x5>;
		sda-gpio = <0x8f>;
	};

	miu_int {
		compatible = "miu_int";
		interrupts = <0x0 0x22 0x4>;
	};

	SE_DSP2UP_intr {
		compatible = "SE_DSP2UP_intr";
		interrupts = <0x0 0x4e 0x4>;
	};

	reg_hst0to2_int {
		compatible = "reg_hst0to2_int";
		interrupts = <0x0 0x65 0x4>;
	};

	DSP2MIPS_INT {
		compatible = "DSP2MIPS_INT";
		interrupts = <0x0 0x5f 0x4>;
	};

	vdmcu2hk_int {
		compatible = "vdmcu2hk_int";
		interrupts = <0x0 0x57 0x4>;
	};

	cec_int_pm {
		compatible = "cec_int_pm";
		interrupts = <0x0 0x11 0x4>;
	};

	sc_hk_int {
		compatible = "sc_hk_int";
		interrupts = <0x0 0xaf 0x4>;
	};

	ext_gpio_int0 {
		compatible = "ext_gpio_int0";
		interrupts = <0x0 0x67 0x4>;
	};

	d2b_int {
		compatible = "d2b_int";
		interrupts = <0x0 0x17 0x4>;
	};

	firmware {

		android {
			mode = "123456789";
			Processor = "AArch64 Processor rev 3 (aarch64)";
			bootloader = "123456789";
			compatible = "android,firmware";
			hardware = "m7642";
			Serial = "0000000000000000";
			baseband = "123456789";
			revision = "1234";

			fstab {
				compatible = "android,fstab";

				vendor {
					dev = "/dev/block/platform/mstar_mci.0/by-name/vendor";
					compatible = "android,vendor";
					mnt_flags = "ro";
					fsmgr_flags = "wait";
					type = "ext4";
				};

				tvconfig {
					dev = "/dev/block/platform/mstar_mci.0/by-name/tvconfig";
					compatible = "android,tvconfig";
					mnt_flags = "ro";
					fsmgr_flags = "wait";
					type = "ext4";
				};
			};
		};
	};

	switch_gpio {
		switch-name = "h2w";
		compatible = "mstar,switch-gpio";
		switch-gpio = <0x3e7>;
		switch-inverse = <0x0>;
	};

	int_uart2 {
		compatible = "int_uart2";
		interrupts = <0x0 0xa9 0x4>;
	};

	Mstar-utopia2k-str {
		compatible = "Mstar-utopia2k-str";

		ace {

			suspend {

				stage0 {
					post-condition = "ace";
				};
			};

			resume {

				stage0 {
					pre-condition = "xc";
					post-condition = "ace";
				};
			};
		};

		vif {

			resume {

				stage0 {
					post-condition = "vif";
				};
			};
		};

		mhl {

			resume {

				stage0 {
					pre-condition = "hdmi_rx";
				};
			};
		};

		xc {

			suspend {

				stage0 {
					pre-condition = "pq", "ace";
					post-condition = "xc";
				};
			};

			resume {

				stage0 {
					pre-condition = "vdec", "avd", "miu", "mvop", "pnl";
					post-condition = "xc";
				};
			};
		};

		miu {

			resume {

				stage0 {
					post-condition = "miu";
				};
			};
		};

		hdmi_rx {

			resume {

				stage0 {
					post-condition = "hdmi_rx";
				};
			};
		};

		avd {

			resume {

				stage0 {
					pre-condition = "vif";
					post-condition = "avd";
				};
			};
		};

		mvop {

			resume {

				stage0 {
					post-condition = "mvop";
				};
			};
		};

		pq {

			suspend {

				stage0 {
					post-condition = "pq";
				};
			};

			resume {

				stage0 {
					pre-condition = "xc";
					post-condition = "pq";
				};
			};
		};

		ve {

			resume {

				stage0 {
					pre-condition = "miu", "xc";
				};
			};
		};

		vdec {

			resume {

				stage0 {
					post-condition = "vdec";
				};
			};
		};

		pnl {

			suspend {

				stage0 {
					pre-condition = "xc";
				};
			};

			resume {

				stage0 {
					post-condition = "pnl";
				};
			};
		};
	};

	hdcp_x74_int {
		compatible = "hdcp_x74_int";
		interrupts = <0x0 0x38 0x4>;
	};

	Mstar-ehci-1 {
		compatible = "Mstar-ehci-1";
	};

	imi_top_irq {
		compatible = "imi_top_irq";
		interrupts = <0x0 0x56 0x4>;
	};

	gpio_wifi_ctl {
		compatible = "mstar,gpio-wifi-ctl";
		wifi-ctl-gpio = <0x11>;
	};

	SPDIF_IN_NON_PCM_INT_OUT {
		compatible = "SPDIF_IN_NON_PCM_INT_OUT";
		interrupts = <0x0 0x4c 0x4>;
	};

	int_timer2 {
		compatible = "int_timer2";
		interrupts = <0x0 0x6d 0x4>;
	};

	smart_int {
		compatible = "smart_int";
		interrupts = <0x0 0x37 0x4>;
	};

	mstar-pm {
		compatible = "mstar-pm";
	};

	dip2_sec_int {
		compatible = "dip2_sec_int";
		interrupts = <0x0 0xc2 0x4>;
	};

	PM_SD_CDZ1_int {
		compatible = "PM_SD_CDZ1_int";
		interrupts = <0x0 0x63 0x4>;
	};

	Mstar-ehci-4 {
		compatible = "Mstar-ehci-4";
	};

	ve_int {
		compatible = "ve_int";
		interrupts = <0x0 0x3a 0x4>;
	};

	cpus {
		#address-cells = <0x2>;
		#size-cells = <0x0>;

		cpu@0 {
			phandle = <0x2>;
			reg = <0x0 0x0>;
			compatible = "arm,cortex-a73", "arm,armv8";
			cpu-release-addr = <0x0 0x100510>;
			enable-method = "mstar-spin-table";
			linux,phandle = <0x2>;
			device_type = "cpu";
		};

		cpu-map {

			cluster0 {
				phandle = <0x8>;
				#cooling-cells = <0x2>;
				linux,phandle = <0x8>;

				core0 {
					cpu = <0x2>;
				};

				core1 {
					cpu = <0x3>;
				};

				core3 {
					cpu = <0x5>;
				};

				core2 {
					cpu = <0x4>;
				};
			};
		};

		cpu@2 {
			phandle = <0x4>;
			reg = <0x0 0x2>;
			compatible = "arm,cortex-a73", "arm,armv8";
			cpu-release-addr = <0x0 0x100510>;
			enable-method = "mstar-spin-table";
			linux,phandle = <0x4>;
			device_type = "cpu";
		};

		cpu@1 {
			phandle = <0x3>;
			reg = <0x0 0x1>;
			compatible = "arm,cortex-a73", "arm,armv8";
			cpu-release-addr = <0x0 0x100510>;
			enable-method = "mstar-spin-table";
			linux,phandle = <0x3>;
			device_type = "cpu";
		};

		cpu@3 {
			phandle = <0x5>;
			reg = <0x0 0x3>;
			compatible = "arm,cortex-a73", "arm,armv8";
			cpu-release-addr = <0x0 0x100510>;
			enable-method = "mstar-spin-table";
			linux,phandle = <0x5>;
			device_type = "cpu";
		};
	};

	xc {
		compatible = "mstar-xc";
	};

	pwm_rp_l_int {
		compatible = "pwm_rp_l_int";
		interrupts = <0x0 0x7b 0x4>;
	};

	dip2_int {
		compatible = "dip2_int";
		interrupts = <0x0 0xc1 0x4>;
	};

	ldm_dma_done_int1 {
		compatible = "ldm_dma_done_int1";
		interrupts = <0x0 0x59 0x4>;
	};

	jpd_int {
		compatible = "jpd_int";
		interrupts = <0x0 0x2d 0x4>;
	};

	mstar-rtc@0 {
		freq = <0x1>;
		compatible = "mstar-rtc";
		xtal = <0xb71b00>;
		index = <0x0>;
	};

	PAS_PTS_INTRL_COMBINE {
		compatible = "PAS_PTS_INTRL_COMBINE";
		interrupts = <0x0 0x31 0x4>;
	};

	lpll_intr {
		compatible = "lpll_intr";
		interrupts = <0x0 0x8 0x4>;
	};

	lzma_irq {
		compatible = "lzma_irq";
		interrupts = <0x0 0xb8 0x4>;
	};

	miu {
		compatible = "mstar-miu";
	};

	reg_hst1to3_int {
		compatible = "reg_hst1to3_int";
		interrupts = <0x0 0x68 0x4>;
	};

	dmdmcu2hk_int {
		compatible = "dmdmcu2hk_int";
		interrupts = <0x0 0x54 0x4>;
	};

	reg_hst3to0_int {
		compatible = "reg_hst3to0_int";
		interrupts = <0x0 0x72 0x4>;
	};

	soc-dvfs {
		cluster = <0x1>;
		package = <0x1>;
		enable = <0x1>;

		cluster_0 {

			cpu-info {
				freqaddr = <0x1f200a04>;
				mcubank = <0x101d00>;
				mask = <0x0>;
				anabank = <0x110c00>;
				partid = <0xd03>;
			};

			table-info_0 {

				sys-info {
					default-clock = <0x3e8>;
					default-cpu = <0x64>;
					max-cpu = <0x78>;
					min-clock = <0x3e8>;
					antutu-clock = <0x55a>;
					protect-clock = <0x320>;
					max-clock = <0x55a>;
					default-core = <0x64>;
					min-cpu = <0x5a>;
					boost-clock = <0x514>;
				};

				temp-info {
					normal_upper = <0x87>;
					normal_lower = <0x78>;
					freeze_lower = <0xff>;
					freeze_upper = <0xff>;
					power-ss = <0x5a>;
					reset = <0x96>;
					power-ff = <0x5a>;
				};

				clock-info {
					level = <0x4>;

					pairs {

						setting_3 {
							min-clock = <0x55a>;
							power-ss = <0x78>;
							max-clock = <0x55b>;
							power-ff = <0x73>;
						};

						setting_1 {
							min-clock = <0x4b0>;
							power-ss = <0x6e>;
							max-clock = <0x514>;
							power-ff = <0x69>;
						};

						setting_2 {
							min-clock = <0x514>;
							power-ss = <0x73>;
							max-clock = <0x55a>;
							power-ff = <0x6e>;
						};

						setting_0 {
							min-clock = <0x3e8>;
							power-ss = <0x64>;
							max-clock = <0x4b0>;
							power-ff = <0x5f>;
						};
					};
				};

				core-info {
					min-clock = <0x258>;
					power-ss = <0x64>;
					max-clock = <0x258>;
					power-ff = <0x5f>;
				};

				power-info {
					type = "i2c";

					parm {
						shift = <0x1>;
						slave-id = <0x80>;
						id = <0x9a>;
						set = "hw";
						step = <0x3>;
						port = <0x3>;
					};
				};
			};
		};
	};

	ci_gpio_int {
		compatible = "ci_gpio_int";
		interrupts = <0x0 0xb1 0x4>;
	};

	reg_hst3to2_int {
		compatible = "reg_hst3to2_int";
		interrupts = <0x0 0x70 0x4>;
	};

	usb_int3 {
		compatible = "usb_int3";
		interrupts = <0x0 0x3e 0x4>;
	};

	reg_hst0to1_int {
		compatible = "reg_hst0to1_int";
		interrupts = <0x0 0x66 0x4>;
	};

	gpio {
		gpio-controller;
		#interrupt-cells = <0x2>;
		interrupt-controller;
		#gpio-cells = <0x1>;
		compatible = "mstar,gpio";
		skip-save-status = <0x6 0x2c 0x4>;
	};

	gpd_int {
		compatible = "gpd_int";
		interrupts = <0x0 0x1e 0x4>;
	};

	aia_mdla_ns_int {
		compatible = "aia_mdla_ns_int";
		interrupts = <0x0 0xbc 0x4>;
	};

	ir_in {
		compatible = "ir_in";
		interrupts = <0x0 0x55 0x4>;
	};

	Mstar-sys {

		firmware {

			audio {
				path = "/mslib/utopia/";
			};
		};
	};

	g3d2mcu_irq_dft {
		compatible = "g3d2mcu_irq_dft";
		interrupts = <0x0 0x35 0x4>;
	};

	mvd2mips_int {
		compatible = "mvd2mips_int";
		interrupts = <0x0 0x1d 0x4>;
	};

	mstar-frc-r2 {
		compatible = "FRC-R2";
	};

	otg_int {
		compatible = "otg_int";
		interrupts = <0x0 0x16 0x4>;
	};

	MB_auR2toMCU_INT0 {
		compatible = "MB_auR2toMCU_INT0";
		interrupts = <0x0 0x5b 0x4>;
	};

	MB_DSP2toMCU_INT1 {
		compatible = "MB_DSP2toMCU_INT1";
		interrupts = <0x0 0x47 0x4>;
	};

	mspi_int {
		compatible = "mspi_int";
		interrupts = <0x0 0xb 0x4>;
	};

	aesdma_s_int {
		compatible = "aesdma_s_int";
		interrupts = <0x0 0x26 0x4>;
	};

	uart2mcu_intr {
		compatible = "uart2mcu_intr";
		interrupts = <0x0 0x32 0x4>;
	};

	scdc_int_pm {
		compatible = "scdc_int_pm";
		interrupts = <0x0 0x15 0x4>;
	};

	chosen {
		bootargs = "root=/dev/ram0 rw init=/sbin/init ip=dhcp console=ttyS0,38400,LX_MEM=0x03000000";
	};

	miic1_int {
		compatible = "miic1_int";
		interrupts = <0x0 0x3d 0x4>;
	};

	usb_int_fiq {
		compatible = "usb_int_fiq";
		interrupts = <0x0 0x48 0x4>;
	};

	mmc_host_sdio {
		pc-option = <0x0 0x0 0x0 0x0>;
		sdio-fast-connect = <0x0>;
		compatible = "mstar, sdio";
		sdio-padmux = <0x1>;
		wp-option = <0x0 0x0 0x0 0x0>;
		sdio-volt-type = <0x0>;
		cd-option = <0x1 0xf 0x1a 0x2>;
	};

	backlight {
		vcc_gpio = <0x2c>;
		default-brightness-level = <0xff>;
		led_gpio = <0x4>;
		bl_ctrl_inverse = <0x0>;
		bl_ctrl = <0x6>;
		compatible = "backlight";
		vcc_gpio_invert = <0x0>;
		brightness-levels = <0x0 0xff>;
		led_gpio_invert = <0x0>;
	};

	memory@20200000 {
		reg = <0x0 0x20200000 0x0 0x8000000>;
		device_type = "memory";
	};

	disp_mfdec_int {
		compatible = "disp_mfdec_int";
		interrupts = <0x0 0x28 0x4>;
	};

	ext_gpio_int6 {
		compatible = "ext_gpio_int6";
		interrupts = <0x0 0x7a 0x4>;
	};

	mtk-sensor@0 {
		phandle = <0x6>;
		#thermal-sensor-cells = <0x1>;
		compatible = "mtk-thermal";
		linux,phandle = <0x6>;
	};

	disp_fe_int {
		compatible = "disp_fe_int";
		interrupts = <0x0 0x12 0x4>;
	};

	lan_esd_int {
		compatible = "lan_esd_int";
		interrupts = <0x0 0x4d 0x4>;
	};

	i2c@0 {
		hw-port = <0x3>;
		pad-mux = <0x19>;
		speed-khz = <0x64>;
		status = "okay";
		compatible = "mstar,swi2c";
		def-delay = <0x64>;
		scl-gpio = <0x36>;
		iic-mode = <0x1>;
		bus-index = <0x0>;
		retries = <0x5>;
		sda-gpio = <0x37>;
	};

	mfe_int {
		compatible = "mfe_int";
		interrupts = <0x0 0xac 0x4>;
	};

	keypad {
		linux,input-no-autorepeat;
		mtk,keypad-lowbd = <0x350>;
		reg = <0x0 0x1f002800 0x0 0x200>;
		compatible = "mtk,hq-keypad";
		mtk,keypad-num = <0x8>;
		interrupts = <0x0 0x1 0x4>;
		mtk,keypad-upwbd = <0x3ff>;
		wakeup-source;
		mtk,keypad-chanel = <0x1>;

		key_8 {
			linux,code = <0x74>;
			keypad,threshold = <0x0>;
		};

		key_2 {
			linux,code = <0x4f>;
			keypad,threshold = <0x2db>;
		};

		key_4 {
			linux,code = <0x72>;
			keypad,threshold = <0x210>;
		};

		key_7 {
			linux,code = <0x192>;
			keypad,threshold = <0x81>;
		};

		key_1 {
			linux,code = <0x8b>;
			keypad,threshold = <0x339>;
		};

		key_5 {
			linux,code = <0x73>;
			keypad,threshold = <0x175>;
		};

		key_3 {
			linux,code = <0x1c>;
			keypad,threshold = <0x275>;
		};

		key_6 {
			linux,code = <0x193>;
			keypad,threshold = <0xf9>;
		};
	};

	usb_int {
		compatible = "usb_int";
		interrupts = <0x0 0x6 0x4>;
	};

	ext_gpio_int5 {
		compatible = "ext_gpio_int5";
		interrupts = <0x0 0x79 0x4>;
	};

	mstar-tsp {
		compatible = "Mstar-tsp";
	};

	Mstar-otg {
		compatible = "Mstar-otg";
	};

	adcpll_irq {
		compatible = "adcpll_irq";
		interrupts = <0x0 0xba 0x4>;
	};

	ramoops@42300000 {
		reg = <0x0 0x42300000 0x0 0x100000>;
		compatible = "ramoops";
		console-size = <0x40000>;
		record-size = <0x40000>;
		ftrace-size = <0x40000>;
		pmsg-size = <0x40000>;
	};

	rtc2_int {
		compatible = "rtc2_int";
		interrupts = <0x0 0x25 0x4>;
	};

	ve_vbi_f1_int {
		compatible = "ve_vbi_f1_int";
		interrupts = <0x0 0x76 0x4>;
	};

	irq_vd_evd_r22hi {
		compatible = "irq_vd_evd_r22hi";
		interrupts = <0x0 0x2 0x4>;
	};

	Mstar-STR {

		Mstar-utopia2k-str {
			suspend-stage1 = "late";
			resume-stage1-waitfor = "mstar_mci.0";
			resume-stage1 = "early";
			policy = "async";
		};

		mmcblk {
			suspend-stage1 = "noirq";
			resume-stage1 = "noirq";
		};

		mstar_mci {
			suspend-stage1 = "late";
			resume-stage1 = "early";
			policy = "async";
		};

		mmcbus {
			suspend-stage1 = "late";
			resume-stage1 = "early";
		};

		mstar-xc {
			suspend-stage1 = "noirq";
			resume-stage1 = "noirq";
		};

		Mstar-mbx {
			suspend-stage1 = "noirq";
			resume-stage1 = "noirq";
		};
	};

	timer {
		compatible = "arm,armv8-timer";
		interrupts = <0x1 0xd 0xff01 0x1 0xe 0xff01 0x1 0xb 0xff01 0x1 0xa 0xff01>;
		clock-frequency = <0xb71b00>;
	};

	pwm_fp_l_int {
		compatible = "pwm_fp_l_int";
		interrupts = <0x0 0x7c 0x4>;
	};

	MB_auR2toMCU_INT1 {
		compatible = "MB_auR2toMCU_INT1";
		interrupts = <0x0 0x5d 0x4>;
	};

	buf_tag {

		xc_sub {
			miu = <0x0>;
			max_size = <0x0 0x1800000>;
			heaptype = <0x0>;
		};

		tsp_filein {
			miu = <0x0>;
			max_size = <0x0 0x240000>;
			heaptype = <0x0>;
		};

		tsp_pvr {
			miu = <0x0>;
			max_size = <0x0 0xd80000>;
			heaptype = <0x0>;
		};

		vdec_es {
			miu = <0x0>;
			max_size = <0x0 0x1c00000>;
			heaptype = <0x0>;
		};

		directfb_frame0 {
			miu = <0x0>;
			max_size = <0x0 0x8000000>;
			heaptype = <0x0>;
		};

		jpd_write {
			miu = <0x0>;
			max_size = <0x0 0x400000>;
			heaptype = <0x0>;
		};

		img_frame {
			miu = <0x0>;
			max_size = <0x0 0x2000000>;
			heaptype = <0x0>;
		};

		tsp_alppvr {
			miu = <0x0>;
			max_size = <0x0 0xc00000>;
			heaptype = <0x0>;
		};

		xc_hdr {
			miu = <0x0>;
			max_size = <0x0 0x3000000>;
			heaptype = <0x0>;
		};

		xc_frc_pq {
			miu = <0x0>;
			max_size = <0x0 0xf00000>;
			heaptype = <0x0>;
		};

		mali_gop {
			max_size = <0x0 0x19000000>;
			heaptype = <0x0>;
			normal_zone = <0x1>;
		};

		xc_main {
			miu = <0x0>;
			max_size = <0x0 0x5f00000>;
			heaptype = <0x0>;
		};

		mali_gop_dma {
			max_size = <0x0 0x6000000>;
			heaptype = <0x0>;
			normal_zone = <0x0>;
		};

		tsp_fiq {
			miu = <0x0>;
			max_size = <0x0 0x402000>;
			heaptype = <0x0>;
		};

		cap_once {
			miu = <0x0>;
			max_size = <0x0 0x4000000>;
			heaptype = <0x0>;
		};

		xc_frc_l {
			miu = <0x0>;
			max_size = <0x0 0x8200000>;
			heaptype = <0x0>;
		};

		directfb_frame1 {
			miu = <0x0>;
			max_size = <0x0 0x1200000>;
			heaptype = <0x0>;
		};

		mdla_buf {
			miu = <0x0>;
			max_size = <0x0 0xec00000>;
			heaptype = <0x0>;
		};

		vdec_fb {
			miu = <0x0>;
			max_size = <0x0 0x15400000>;
			heaptype = <0x0>;
		};
	};

	AU_DMA_BUFFER_INT_EDGE {
		compatible = "AU_DMA_BUFFER_INT_EDGE";
		interrupts = <0x0 0x61 0x4>;
	};

	MB_auR2toMCU_INT3 {
		compatible = "MB_auR2toMCU_INT3";
		interrupts = <0x0 0x60 0x4>;
	};

	emac_int {
		compatible = "emac_int";
		interrupts = <0x0 0x9 0x4>;
	};

	i2c@2 {
		hw-port = <0x2>;
		pad-mux = <0x13>;
		speed-khz = <0x64>;
		status = "okay";
		compatible = "mstar,swi2c";
		def-delay = <0x64>;
		scl-gpio = <0x40>;
		iic-mode = <0x1>;
		bus-index = <0x2>;
		retries = <0x5>;
		sda-gpio = <0x41>;
	};

	frc_irq {
		compatible = "frc_irq";
		interrupts = <0x0 0xb6 0x4>;
	};

	usb_int_merge2 {
		compatible = "usb_int_merge2";
		interrupts = <0x0 0x75 0x4>;
	};

	edmc@1078c000 {
		reg = <0x0 0x1f3ec000 0x0 0x1000>;
		compatible = "mtk,edmc";
		interrupts = <0x0 0xbe 0x4>;
	};

	ge_int {
		compatible = "ge_int";
		interrupts = <0x0 0xc 0x4>;
	};

	wadr_err_int {
		compatible = "wadr_err_int";
		interrupts = <0x0 0x39 0x4>;
	};

	usc_int1 {
		compatible = "usc_int1";
		interrupts = <0x0 0xa7 0x4>;
	};

	alsa {
		compatible = "Mstar-alsa";
	};

	int_wdt {
		compatible = "int_wdt";
		interrupts = <0x0 0x42 0x4>;
	};

	uhc_int_fiq {
		compatible = "uhc_int_fiq";
		interrupts = <0x0 0x49 0x4>;
	};

	ve_vbi_f0_int {
		compatible = "ve_vbi_f0_int";
		interrupts = <0x0 0x74 0x4>;
	};

	gop_int {
		compatible = "gop_int";
		interrupts = <0x0 0x14 0x4>;
	};

	int_timer1 {
		compatible = "int_timer1";
		interrupts = <0x0 0x41 0x4>;
	};

	MB_DSP2toMCU_INT0 {
		compatible = "MB_DSP2toMCU_INT0";
		interrupts = <0x0 0x46 0x4>;
	};

	ext_gpio_int3 {
		compatible = "ext_gpio_int3";
		interrupts = <0x0 0x77 0x4>;
	};

	uart0 {
		compatible = "mstar8250-uart";
		interrupts = <0x0 0x0 0x4>;
	};

	emac {
		compatible = "mstar-emac";
	};

	dc_sub_int {
		compatible = "dc_sub_int";
		interrupts = <0x0 0xbb 0x4>;
	};

	scaler {
		compatible = "mstar-scaler";
	};

	reg_hst1to0_int {
		compatible = "reg_hst1to0_int";
		interrupts = <0x0 0x6a 0x4>;
	};

	pmu {
		compatible = "arm,armv8-pmuv3";
		interrupts = <0x0 0x86 0x4 0x0 0x88 0x4 0x0 0x8a 0x4 0x0 0x8c 0x4>;
	};

	error_resp_int {
		compatible = "error_resp_int";
		interrupts = <0x0 0x23 0x4>;
	};

	usb_int2 {
		compatible = "usb_int2";
		interrupts = <0x0 0x24 0x4>;
	};

	int_all {
		compatible = "int_all";
		interrupts = <0x0 0x62 0x4>;
	};

	gflip {
		compatible = "mstar-gflip";
	};

	urdma2mcu_intr {
		compatible = "urdma2mcu_intr";
		interrupts = <0x0 0x33 0x4>;
	};

	vivaldi_pts_intr {
		compatible = "vivaldi_pts_intr";
		interrupts = <0x0 0x51 0x4>;
	};

	mvd_int {
		compatible = "mvd_int";
		interrupts = <0x0 0x3 0x4>;
	};

	disp_be_int {
		compatible = "disp_be_int";
		interrupts = <0x0 0xa 0x4>;
	};

	DSP_MIU_PROT_intr {
		compatible = "DSP_MIU_PROT_intr";
		interrupts = <0x0 0x52 0x4>;
	};

	ve_done_TT_irq {
		compatible = "ve_done_TT_irq";
		interrupts = <0x0 0x4a 0x4>;
	};

	nfie_int {
		compatible = "nfie_int";
		interrupts = <0x0 0x5 0x4>;
	};

	acpu_int {
		compatible = "acpu_int";
		interrupts = <0x0 0x3c 0x4>;
	};

	fsp_demura_irq {
		compatible = "fsp_demura_irq";
		interrupts = <0x0 0xb7 0x4>;
	};

	AUDMA_V2_INTR {
		compatible = "AUDMA_V2_INTR";
		interrupts = <0x0 0x18 0x4>;
	};

	AFEC_VSYNC {
		compatible = "AFEC_VSYNC";
		interrupts = <0x0 0x5c 0x4>;
	};

	interrupt-controller@16001000 {
		phandle = <0x1>;
		#interrupt-cells = <0x3>;
		interrupt-controller;
		reg = <0x0 0x16001000 0x0 0x1000 0x0 0x16002000 0x0 0x4000>;
		compatible = "arm,cortex-a15-gic", "arm,cortex-a9-gic";
		#address-cells = <0x0>;
		interrupts = <0x1 0x9 0xf04>;
		linux,phandle = <0x1>;
	};

	mbx {
		compatible = "mstar-mbx";
	};

	Mstar-ehci-2 {
		compatible = "Mstar-ehci-2";
	};

	uhb_int1 {
		compatible = "uhb_int1";
		interrupts = <0x0 0xa8 0x4>;
	};

	ext_gpio_int1 {
		compatible = "ext_gpio_int1";
		interrupts = <0x0 0x6b 0x4>;
	};

	miic0_int {
		compatible = "miic0_int";
		interrupts = <0x0 0x3f 0x4>;
	};

	usb_int_merge1 {
		compatible = "usb_int_merge1";
		interrupts = <0x0 0x73 0x4>;
	};

	aia_conn_int {
		compatible = "aia_conn_int";
		interrupts = <0x0 0xbd 0x4>;
	};

	dvi_hdmi_hdcp_int {
		compatible = "dvi_hdmi_hdcp_int";
		interrupts = <0x0 0x34 0x4>;
	};

	hdmitx4vx1 {
		compatible = "mstar-hdmitx4vx1";
	};

	tsp2hk_int {
		compatible = "tsp2hk_int";
		interrupts = <0x0 0x10 0x4>;
	};

	pm_irq_out {
		compatible = "pm_irq_out";
		interrupts = <0x0 0x2e 0x4>;
	};

	tsp_fi_queue_int {
		compatible = "tsp_fi_queue_int";
		interrupts = <0x0 0xb3 0x4>;
	};

	dipw_INT {
		compatible = "dipw_INT";
		interrupts = <0x0 0x2b 0x4>;
	};

	aia_dmac_int {
		compatible = "aia_dmac_int";
		interrupts = <0x0 0xbe 0x4>;
	};

	mdla {
		reg = <0x0 0x1f3e8000 0x0 0x1000 0x0 0x1f3e9000 0x0 0x1000 0x0 0x1f3ea000 0x0 0x1000 0x0 0x1fe00000 0x0 0x80000>;
		compatible = "mtk,mdla";
		interrupts = <0x0 0xbc 0x4>;
	};

	ext_gpio_int7 {
		compatible = "ext_gpio_int7";
		interrupts = <0x0 0x7f 0x4>;
	};

	Mstar-ehci-3 {
		compatible = "Mstar-ehci-3";
	};

	int_timer0 {
		compatible = "int_timer0";
		interrupts = <0x0 0x40 0x4>;
	};

	pwm_fp_r_int {
		compatible = "pwm_fp_r_int";
		interrupts = <0x0 0x7e 0x4>;
	};

	ir {
		compatible = "mstar-ir";
	};

	reg_hst0to3_int {
		compatible = "reg_hst0to3_int";
		interrupts = <0x0 0x64 0x4>;
	};

	tso_int {
		compatible = "tso_int";
		interrupts = <0x0 0x1f 0x4>;
	};

	tsen_1_ov_irq {
		compatible = "tsen_1_ov_irq";
		interrupts = <0x0 0xb5 0x4>;
	};

	emac_man_int {
		compatible = "emac_man_int";
		interrupts = <0x0 0x69 0x4>;
	};

	aia_mdla_s_int {
		compatible = "aia_mdla_s_int";
		interrupts = <0x0 0xc0 0x4>;
	};

	AU_SPDIF_TX_CS_INT0 {
		compatible = "AU_SPDIF_TX_CS_INT0";
		interrupts = <0x0 0x44 0x4>;
	};

	hvd_int {
		compatible = "hvd_int";
		interrupts = <0x0 0x20 0x4>;
	};

	ldm_dma_done_int0 {
		compatible = "ldm_dma_done_int0";
		interrupts = <0x0 0x58 0x4>;
	};

	miu_security_int {
		compatible = "miu_security_int";
		interrupts = <0x0 0x2a 0x4>;
	};

	earc_tx_int {
		compatible = "earc_tx_int";
		interrupts = <0x0 0xb0 0x4>;
	};

	blkprearb_auto_bist_int {
		compatible = "blkprearb_auto_bist_int";
		interrupts = <0x0 0xaa 0x4>;
	};

	spi@0x1003 {
		mspi_channel = <0x2>;
		reg = <0x0 0x0 0x200600 0x1000>;
		status = "okay";
		compatible = "mstar,mstar-mspi";
		#address-cells = <0x1>;
		interrupts = <0x2b>;
		#size-cells = <0x0>;

		spidev@1 {
			reg = <0x0>;
			compatible = "spidev";
			spi-max-frequency = <0x1e8480>;
		};
	};

	cmdq_int {
		compatible = "cmdq_int";
		interrupts = <0x0 0xad 0x4>;
	};

	vivaldi_str_intr {
		compatible = "vivaldi_str_intr";
		interrupts = <0x0 0x50 0x4>;
	};

	PM_SD_CDZ_int {
		compatible = "PM_SD_CDZ_int";
		interrupts = <0x0 0x5a 0x4>;
	};

	ext_gpio_int2 {
		compatible = "ext_gpio_int2";
		interrupts = <0x0 0x6f 0x4>;
	};

	tsen_0_ov_irq {
		compatible = "tsen_0_ov_irq";
		interrupts = <0x0 0xb4 0x4>;
	};

	miic3_int {
		compatible = "miic3_int";
		interrupts = <0x0 0xa6 0x4>;
	};

	reg_hst3to1_int {
		compatible = "reg_hst3to1_int";
		interrupts = <0x0 0x71 0x4>;
	};

	ps {
		compatible = "Mstar-mvd";
	};
};
